## Kconfig
```kconfig
# SPDX-FileCopyrightText: 2025 Ronny Eia <3652665+eiaro@users.noreply.github.com>
#
# SPDX-License-Identifier: MIT

menu "MAX31856 Configuration"

config MAX31856_ENABLE_DEBUG_LOG
    bool "Enable debug logging for MAX31856"
    default n
    help
        Enables debug level logging for the MAX31856 thermocouple driver.
        This provides detailed information about register reads and writes
        and is useful for troubleshooting SPI communication issues.

endmenu
```

## Kconfig.projbuild
```kconfig
menu "MAX31856 Configuration"

config MAX31856_ENABLE_DEBUG_LOG
    bool "Enable debug logging for MAX31856"
    default n
    help
        Enables debug level logging for the MAX31856 thermocouple driver.
        This provides detailed information about register reads and writes
        and is useful for troubleshooting SPI communication issues.

endmenu
```

## examples/max31856_basic/sdkconfig.defaults
```kconfig
# SPDX-FileCopyrightText: 2025 Ronny Eia <3652665+eiaro@users.noreply.github.com>
# SPDX-License-Identifier: MIT

CONFIG_MAX31856_ENABLE_DEBUG_LOG=y
CONFIG_LOG_DEFAULT_LEVEL=4
CONFIG_LOG_DEFAULT_LEVEL_DEBUG=y
```
